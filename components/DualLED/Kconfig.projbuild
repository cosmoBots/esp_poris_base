## components/DualLED/Kconfig.projbuild
```kconfig
menu "DualLED settings"

config PORIS_ENABLE_DUALLED
    bool "Enable component DualLED"
    default y
    help
      Enable/disable component DualLED at Kconfig level.
      Variant gating is handled by environment variables (PORIS_ENABLE_DUALLED).

config DUALLED_USE_THREAD
    bool "DualLED starts its own thread (DualLED starts its own thread)"
    default n
    help
      If enabled, DualLED will create a FreeRTOS task and call spin()
      periodically. If disabled, call DualLED_spin() yourself from
      your scheduler.
    depends on PORIS_ENABLE_DUALLED

config DUALLED_PERIOD_MS
    int "DualLED period (ms)"
    range 10 600000
    default 1000
    depends on DUALLED_USE_THREAD

config DUALLED_MINIMIZE_JITTER
    bool "Enable jitter minimization for execution cycles"
    default y
    help
      If active, the delay between loops will use vTaskDelayUntil() to guarantee long cycles will not shift the period, minimizing jitter.
      If deactivate, the component will use vTaskDelay() so the time it wait between cycles is the period.  Long cycles will introduce a shift in the period.
    depends on DUALLED_USE_THREAD

choice DUALLED_PIN_CORE
    prompt "Pin task to core"
    default DUALLED_PIN_CORE_ANY
    depends on DUALLED_USE_THREAD
    help
      Choose which core to pin the task to (or none).
config DUALLED_PIN_CORE_ANY
    bool "Any core (no affinity)"
config DUALLED_PIN_CORE_0
    bool "Core 0"
config DUALLED_PIN_CORE_1
    bool "Core 1"
endchoice

config DUALLED_TASK_STACK
    int "Task stack size (bytes)"
    range 2048 65536
    default 4096
    depends on DUALLED_USE_THREAD

config DUALLED_TASK_PRIO
    int "Task priority"
    range 1 24
    default 5
    depends on DUALLED_USE_THREAD

config DUALLED_ALLOW_BOTH
    bool "Allow both colors simultaneously"
    default y
    help
      Enable states that drive both colors at once. Disable for 2-pin LEDs where one color is the return path of the other.

config DUALLED_RED_GPIO
    int "Red LED GPIO"
    default 7
    range 0 49
    help
      GPIO number for the red LED.

config DUALLED_GREEN_GPIO
    int "Green LED GPIO"
    default 5
    range 0 49
    help
      GPIO number for the green LED.

endmenu
```

## components/DualLedTester/Kconfig.projbuild
```kconfig
menu "DualLedTester settings"

config PORIS_ENABLE_DUALLEDTESTER
    bool "Enable component DualLedTester"
    default y
    help
      Enable/disable component DualLedTester at Kconfig level.
      Variant gating is handled by environment variables (PORIS_ENABLE_DUALLEDTESTER).

config DUALLEDTESTER_USE_THREAD
    bool "DualLedTester starts its own thread (DualLedTester starts its own thread)"
    default n
    help
      If enabled, DualLedTester will create a FreeRTOS task and call spin()
      periodically. If disabled, call DualLedTester_spin() yourself from
      your scheduler.
    depends on PORIS_ENABLE_DUALLEDTESTER

config DUALLEDTESTER_PERIOD_MS
    int "DualLedTester period (ms)"
    range 10 600000
    default 1000
    depends on DUALLEDTESTER_USE_THREAD

config DUALLEDTESTER_MINIMIZE_JITTER
    bool "Enable jitter minimization for execution cycles"
    default y
    help
      If active, the delay between loops will use vTaskDelayUntil() to guarantee long cycles will not shift the period, minimizing jitter.
      If deactivate, the component will use vTaskDelay() so the time it wait between cycles is the period.  Long cycles will introduce a shift in the period.
    depends on DUALLEDTESTER_USE_THREAD

choice DUALLEDTESTER_PIN_CORE
    prompt "Pin task to core"
    default DUALLEDTESTER_PIN_CORE_ANY
    depends on DUALLEDTESTER_USE_THREAD
    help
      Choose which core to pin the task to (or none).
config DUALLEDTESTER_PIN_CORE_ANY
    bool "Any core (no affinity)"
config DUALLEDTESTER_PIN_CORE_0
    bool "Core 0"
config DUALLEDTESTER_PIN_CORE_1
    bool "Core 1"
endchoice

config DUALLEDTESTER_TASK_STACK
    int "Task stack size (bytes)"
    range 2048 65536
    default 4096
    depends on DUALLEDTESTER_USE_THREAD

config DUALLEDTESTER_TASK_PRIO
    int "Task priority"
    range 1 24
    default 5
    depends on DUALLEDTESTER_USE_THREAD

config DUALLEDTESTER_VERBOSE_MODE
    bool "Enable verbose logs (state transitions)"
    default n
    help
      When enabled, DualLedTester will log the state name on each transition.

endmenu
```

## components/HelloWorld/Kconfig.projbuild
```kconfig
menu "HelloWorld settings"

config PORIS_ENABLE_HELLOWORLD
    bool "Enable component HelloWorld"
    default y
    help
      Enable/disable component HelloWorld at Kconfig level.
      Variant gating is handled by environment variables (PORIS_ENABLE_HELLOWORLD).

config HELLOWORLD_USE_THREAD
    bool "HelloWorld starts its own thread (HelloWorld starts its own thread)"
    default n
    help
      If enabled, HelloWorld will create a FreeRTOS task and call spin()
      periodically. If disabled, call HelloWorld_spin() yourself from
      your scheduler.
    depends on PORIS_ENABLE_HELLOWORLD

config HELLOWORLD_PERIOD_MS
    int "HelloWorld period (ms)"
    range 10 600000
    default 1000
    depends on HELLOWORLD_USE_THREAD

config HELLOWORLD_MINIMIZE_JITTER
    bool "Enable jitter minimization for execution cycles"
    default y
    help
      If active, the delay between loops will use vTaskDelayUntil() to guarantee long cycles will not shift the period, minimizing jitter.
      If deactivate, the component will use vTaskDelay() so the time it wait between cycles is the period.  Long cycles will introduce a shift in the period.
    depends on HELLOWORLD_USE_THREAD

choice HELLOWORLD_PIN_CORE
    prompt "Pin task to core"
    default HELLOWORLD_PIN_CORE_ANY
    depends on HELLOWORLD_USE_THREAD
    help
      Choose which core to pin the task to (or none).
config HELLOWORLD_PIN_CORE_ANY
    bool "Any core (no affinity)"
config HELLOWORLD_PIN_CORE_0
    bool "Core 0"
config HELLOWORLD_PIN_CORE_1
    bool "Core 1"
endchoice

config HELLOWORLD_TASK_STACK
    int "Task stack size (bytes)"
    range 2048 65536
    default 4096
    depends on HELLOWORLD_USE_THREAD

config HELLOWORLD_TASK_PRIO
    int "Task priority"
    range 1 24
    default 5
    depends on HELLOWORLD_USE_THREAD

endmenu
```

## components/LcdScreen/Kconfig.projbuild
```kconfig
menu "LcdScreen settings"

config PORIS_ENABLE_LCDSCREEN
    bool "Enable component LcdScreen"
    default y
    help
      Enable/disable component LcdScreen at Kconfig level.
      Variant gating is handled by environment variables (PORIS_ENABLE_LCDSCREEN).

config LCDSCREEN_USE_THREAD
    bool "LcdScreen starts its own thread (LcdScreen starts its own thread)"
    default n
    help
      If enabled, LcdScreen will create a FreeRTOS task and call spin()
      periodically. If disabled, call LcdScreen_spin() yourself from
      your scheduler.
    depends on PORIS_ENABLE_LCDSCREEN

config LCDSCREEN_PERIOD_MS
    int "LcdScreen period (ms)"
    range 10 600000
    default 1000
    depends on LCDSCREEN_USE_THREAD

config LCDSCREEN_MINIMIZE_JITTER
    bool "Enable jitter minimization for execution cycles"
    default y
    help
      If active, the delay between loops will use vTaskDelayUntil() to guarantee long cycles will not shift the period, minimizing jitter.
      If deactivate, the component will use vTaskDelay() so the time it wait between cycles is the period.  Long cycles will introduce a shift in the period.
    depends on LCDSCREEN_USE_THREAD

choice LCDSCREEN_PIN_CORE
    prompt "Pin task to core"
    default LCDSCREEN_PIN_CORE_ANY
    depends on LCDSCREEN_USE_THREAD
    help
      Choose which core to pin the task to (or none).
config LCDSCREEN_PIN_CORE_ANY
    bool "Any core (no affinity)"
config LCDSCREEN_PIN_CORE_0
    bool "Core 0"
config LCDSCREEN_PIN_CORE_1
    bool "Core 1"
endchoice

config LCDSCREEN_TASK_STACK
    int "Task stack size (bytes)"
    range 2048 65536
    default 4096
    depends on LCDSCREEN_USE_THREAD

config LCDSCREEN_TASK_PRIO
    int "Task priority"
    range 1 24
    default 5
    depends on LCDSCREEN_USE_THREAD

endmenu
```

## components/MQTTComm/Kconfig.projbuild
```kconfig
menu "MQTTComm settings"

config PORIS_ENABLE_MQTTCOMM
    bool "Enable component MQTTComm"
    default y
    help
      Enable/disable component MQTTComm at Kconfig level.
      Variant gating is handled by environment variables (PORIS_ENABLE_MQTTCOMM).

config MQTTCOMM_USE_THREAD
    bool "MQTTComm starts its own thread (MQTTComm starts its own thread)"
    default n
    help
      If enabled, MQTTComm will create a FreeRTOS task and call spin()
      periodically. If disabled, call MQTTComm_spin() yourself from
      your scheduler.
    depends on PORIS_ENABLE_MQTTCOMM

config MQTTCOMM_PERIOD_MS
    int "MQTTComm period (ms)"
    range 10 600000
    default 1000
    depends on MQTTCOMM_USE_THREAD

config MQTTCOMM_MINIMIZE_JITTER
    bool "Enable jitter minimization for execution cycles"
    default y
    help
      If active, the delay between loops will use vTaskDelayUntil() to guarantee long cycles will not shift the period, minimizing jitter.
      If deactivate, the component will use vTaskDelay() so the time it wait between cycles is the period.  Long cycles will introduce a shift in the period.
    depends on MQTTCOMM_USE_THREAD

choice MQTTCOMM_PIN_CORE
    prompt "Pin task to core"
    default MQTTCOMM_PIN_CORE_ANY
    depends on MQTTCOMM_USE_THREAD
    help
      Choose which core to pin the task to (or none).
config MQTTCOMM_PIN_CORE_ANY
    bool "Any core (no affinity)"
config MQTTCOMM_PIN_CORE_0
    bool "Core 0"
config MQTTCOMM_PIN_CORE_1
    bool "Core 1"
endchoice

config MQTTCOMM_TASK_STACK
    int "Task stack size (bytes)"
    range 2048 65536
    default 4096
    depends on MQTTCOMM_USE_THREAD

config MQTTCOMM_TASK_PRIO
    int "Task priority"
    range 1 24
    default 5
    depends on MQTTCOMM_USE_THREAD

menu "MQTT Comm Configuration"

    config BROKER_URL
        string "Broker URL"
        default "mqtt://big.cosmobots.eu"
        help
            URL of the broker to connect to

    config BROKER_URL_FROM_STDIN
        bool
        default y if BROKER_URL = "FROM_STDIN"

    config MQTT_TOPIC_ORGANIZATION
        string "MQTT topic organization"
        default "cBots"
        help
            First segment of the MQTT topic path.

    config MQTT_TOPIC_APIVERSION
        string "MQTT topic API version"
        default "v1"
        help
            Second segment of the MQTT topic path.

    config MQTT_TOPIC_SITE
        string "MQTT topic site"
        default "MyHome"
        help
            Third segment of the MQTT topic path (site/installation).

    config MQTT_TOPIC_DEVICE_USE_WIFI_MAC
        bool "Use Wi-Fi MAC as device topic"
        default y
        help
            If enabled, the device segment of the topic will use the Wi-Fi MAC (no separators).
            If disabled, use MQTT_TOPIC_DEVICE_NAME.

    config MQTT_TOPIC_DEVICE_NAME
        string "MQTT topic device name"
        default "TempCtrl"
        depends on !MQTT_TOPIC_DEVICE_USE_WIFI_MAC
        help
            Device segment of the topic when not using Wi-Fi MAC.

    config MQTT_CLIENT_ID_USE_DEVICE
        bool "Client ID uses device segment"
        default y
        help
            If enabled, the MQTT client ID will be the device segment (MAC or name).
            If disabled, use MQTT_CLIENT_ID_CUSTOM.

    config MQTT_CLIENT_ID_CUSTOM
        string "Custom MQTT client ID"
        default ""
        depends on !MQTT_CLIENT_ID_USE_DEVICE
        help
            Custom client ID. Leave empty to fall back to device segment.

endmenu


endmenu
```

## components/Measurement/Kconfig.projbuild
```kconfig
menu "Measurement settings"

config PORIS_ENABLE_MEASUREMENT
    bool "Enable component Measurement"
    default y
    help
      Enable/disable component Measurement at Kconfig level.
      Variant gating is handled by environment variables (PORIS_ENABLE_MEASUREMENT).

config MEASUREMENT_USE_THREAD
    bool "Measurement starts its own thread (Measurement starts its own thread)"
    default n
    help
      If enabled, Measurement will create a FreeRTOS task and call spin()
      periodically. If disabled, call Measurement_spin() yourself from
      your scheduler.
    depends on PORIS_ENABLE_MEASUREMENT

config MEASUREMENT_PERIOD_MS
    int "Measurement period (ms)"
    range 10 600000
    default 1000
    depends on MEASUREMENT_USE_THREAD

config MEASUREMENT_MINIMIZE_JITTER
    bool "Enable jitter minimization for execution cycles"
    default y
    help
      If active, the delay between loops will use vTaskDelayUntil() to guarantee long cycles will not shift the period, minimizing jitter.
      If deactivate, the component will use vTaskDelay() so the time it wait between cycles is the period.  Long cycles will introduce a shift in the period.
    depends on MEASUREMENT_USE_THREAD

choice MEASUREMENT_PIN_CORE
    prompt "Pin task to core"
    default MEASUREMENT_PIN_CORE_ANY
    depends on MEASUREMENT_USE_THREAD
    help
      Choose which core to pin the task to (or none).
config MEASUREMENT_PIN_CORE_ANY
    bool "Any core (no affinity)"
config MEASUREMENT_PIN_CORE_0
    bool "Core 0"
config MEASUREMENT_PIN_CORE_1
    bool "Core 1"
endchoice

config MEASUREMENT_TASK_STACK
    int "Task stack size (bytes)"
    range 2048 65536
    default 4096
    depends on MEASUREMENT_USE_THREAD

config MEASUREMENT_TASK_PRIO
    int "Task priority"
    range 1 24
    default 5
    depends on MEASUREMENT_USE_THREAD

config MEASUREMENT_ENABLE_SIMULATION
    bool "Enable simulation"
    default y
    help
      Enable/disable Measurement simulation creating some netvars and simulated behavior.
    depends on PORIS_ENABLE_MEASUREMENT
endmenu
```

## components/OtCoap/Kconfig.projbuild
```kconfig
menu "OtCoap settings"

config PORIS_ENABLE_OTCOAP
    bool "Enable component OtCoap"
    default y
    help
      Enable/disable component OtCoap at Kconfig level.
      Variant gating is handled by environment variables (PORIS_ENABLE_OTCOAP).

config OTCOAP_USE_THREAD
    bool "OtCoap starts its own thread (OtCoap starts its own thread)"
    default n
    help
      If enabled, OtCoap will create a FreeRTOS task and call spin()
      periodically. If disabled, call OtCoap_spin() yourself from
      your scheduler.
    depends on PORIS_ENABLE_OTCOAP

config OTCOAP_PERIOD_MS
    int "OtCoap period (ms)"
    range 10 600000
    default 1000
    depends on OTCOAP_USE_THREAD

choice OTCOAP_PIN_CORE
    prompt "Pin task to core"
    default OTCOAP_PIN_CORE_ANY
    depends on OTCOAP_USE_THREAD
    help
      Choose which core to pin the task to (or none).
config OTCOAP_PIN_CORE_ANY
    bool "Any core (no affinity)"
config OTCOAP_PIN_CORE_0
    bool "Core 0"
config OTCOAP_PIN_CORE_1
    bool "Core 1"
endchoice

config OTCOAP_TASK_STACK
    int "Task stack size (bytes)"
    range 2048 65536
    default 4096
    depends on OTCOAP_USE_THREAD

config OTCOAP_TASK_PRIO
    int "Task priority"
    range 1 24
    default 5
    depends on OTCOAP_USE_THREAD

endmenu
```

## components/PrjCfg/Kconfig.projbuild
```kconfig
menu "PrjConfig settings"

config PORIS_ENABLE_PRJCFG
    bool "Enable component PrjCfg"
    default y
    help
      Enable/disable component PrjCfg at Kconfig level.
      Variant gating is handled by environment variables (PORIS_ENABLE_PRJCFG).

endmenu
```
