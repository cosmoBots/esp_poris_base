## components/Provisioning/Kconfig.projbuild
```kconfig
menu "Provisioning settings"

config PORIS_ENABLE_PROVISIONING
    bool "Enable component Provisioning"
    default y
    help
      Enable/disable component Provisioning at Kconfig level.
      Variant gating is handled by environment variables (PORIS_ENABLE_PROVISIONING).

config PROVISIONING_USE_THREAD
    bool "Provisioning starts its own thread (Provisioning starts its own thread)"
    default n
    help
      If enabled, Provisioning will create a FreeRTOS task and call spin()
      periodically. If disabled, call Provisioning_spin() yourself from
      your scheduler.
    depends on PORIS_ENABLE_PROVISIONING

config PROVISIONING_PERIOD_MS
    int "Provisioning period (ms)"
    range 10 600000
    default 1000
    depends on PROVISIONING_USE_THREAD

config PROVISIONING_MINIMIZE_JITTER
    bool "Enable jitter minimization for execution cycles"
    default y
    help
      If active, the delay between loops will use vTaskDelayUntil() to guarantee long cycles will not shift the period, minimizing jitter.
      If deactivate, the component will use vTaskDelay() so the time it wait between cycles is the period.  Long cycles will introduce a shift in the period.
    depends on PROVISIONING_USE_THREAD

choice PROVISIONING_PIN_CORE
    prompt "Pin task to core"
    default PROVISIONING_PIN_CORE_ANY
    depends on PROVISIONING_USE_THREAD
    help
      Choose which core to pin the task to (or none).
config PROVISIONING_PIN_CORE_ANY
    bool "Any core (no affinity)"
config PROVISIONING_PIN_CORE_0
    bool "Core 0"
config PROVISIONING_PIN_CORE_1
    bool "Core 1"
endchoice

config PROVISIONING_TASK_STACK
    int "Task stack size (bytes)"
    range 2048 65536
    default 4096
    depends on PROVISIONING_USE_THREAD

config PROVISIONING_TASK_PRIO
    int "Task priority"
    range 1 24
    default 5
    depends on PROVISIONING_USE_THREAD

endmenu
```

## components/Relays/Kconfig.projbuild
```kconfig
menu "Relays settings"

config PORIS_ENABLE_RELAYS
    bool "Enable component Relays"
    default y
    help
      Enable/disable component Relays at Kconfig level.
      Variant gating is handled by environment variables (PORIS_ENABLE_RELAYS).

config RELAYS_USE_THREAD
    bool "Relays starts its own thread (Relays starts its own thread)"
    default n
    help
      If enabled, Relays will create a FreeRTOS task and call spin()
      periodically. If disabled, call Relays_spin() yourself from
      your scheduler.
    depends on PORIS_ENABLE_RELAYS

config RELAYS_PERIOD_MS
    int "Relays period (ms)"
    range 10 600000
    default 1000
    depends on RELAYS_USE_THREAD

config RELAYS_MINIMIZE_JITTER
    bool "Enable jitter minimization for execution cycles"
    default y
    help
      If active, the delay between loops will use vTaskDelayUntil() to guarantee long cycles will not shift the period, minimizing jitter.
      If deactivate, the component will use vTaskDelay() so the time it wait between cycles is the period.  Long cycles will introduce a shift in the period.
    depends on RELAYS_USE_THREAD

choice RELAYS_PIN_CORE
    prompt "Pin task to core"
    default RELAYS_PIN_CORE_ANY
    depends on RELAYS_USE_THREAD
    help
      Choose which core to pin the task to (or none).
config RELAYS_PIN_CORE_ANY
    bool "Any core (no affinity)"
config RELAYS_PIN_CORE_0
    bool "Core 0"
config RELAYS_PIN_CORE_1
    bool "Core 1"
endchoice

config RELAYS_TASK_STACK
    int "Task stack size (bytes)"
    range 2048 65536
    default 4096
    depends on RELAYS_USE_THREAD

config RELAYS_TASK_PRIO
    int "Task priority"
    range 1 24
    default 5
    depends on RELAYS_USE_THREAD

config RELAYS_COUNT
    int "Number of relays"
    range 1 16
    default 2
    help
      Total number of relays managed by this component.

config RELAYS_GPIO_LIST
    string "Relay GPIO list (comma-separated)"
    default "4,5"
    help
      Comma-separated list of GPIO numbers, one per relay, in order.

config RELAYS_ALLOW_MULTIPLE
    bool "Allow multiple relays on simultaneously"
    default y
    help
      If disabled, requests that turn on multiple relays at once should be rejected (useful for HW that forbids parallel activation).

endmenu
```

## components/RelaysTest/Kconfig.projbuild
```kconfig
menu "RelaysTest settings"

config PORIS_ENABLE_RELAYSTEST
    bool "Enable component RelaysTest"
    default y
    help
      Enable/disable component RelaysTest at Kconfig level.
      Variant gating is handled by environment variables (PORIS_ENABLE_RELAYSTEST).

config RELAYSTEST_USE_THREAD
    bool "RelaysTest starts its own thread (RelaysTest starts its own thread)"
    default n
    help
      If enabled, RelaysTest will create a FreeRTOS task and call spin()
      periodically. If disabled, call RelaysTest_spin() yourself from
      your scheduler.
    depends on PORIS_ENABLE_RELAYSTEST

config RELAYSTEST_PERIOD_MS
    int "RelaysTest period (ms)"
    range 10 600000
    default 1000
    depends on RELAYSTEST_USE_THREAD

config RELAYSTEST_MINIMIZE_JITTER
    bool "Enable jitter minimization for execution cycles"
    default y
    help
      If active, the delay between loops will use vTaskDelayUntil() to guarantee long cycles will not shift the period, minimizing jitter.
      If deactivate, the component will use vTaskDelay() so the time it wait between cycles is the period.  Long cycles will introduce a shift in the period.
    depends on RELAYSTEST_USE_THREAD

choice RELAYSTEST_PIN_CORE
    prompt "Pin task to core"
    default RELAYSTEST_PIN_CORE_ANY
    depends on RELAYSTEST_USE_THREAD
    help
      Choose which core to pin the task to (or none).
config RELAYSTEST_PIN_CORE_ANY
    bool "Any core (no affinity)"
config RELAYSTEST_PIN_CORE_0
    bool "Core 0"
config RELAYSTEST_PIN_CORE_1
    bool "Core 1"
endchoice

config RELAYSTEST_TASK_STACK
    int "Task stack size (bytes)"
    range 2048 65536
    default 4096
    depends on RELAYSTEST_USE_THREAD

config RELAYSTEST_TASK_PRIO
    int "Task priority"
    range 1 24
    default 5
    depends on RELAYSTEST_USE_THREAD

config RELAYSTEST_DWELL_MS
    int "Dwell time per relay (ms)"
    range 100 60000
    default 5000
    help
      Time each relay stays ON during the test cycle.

config RELAYSTEST_VERBOSE_MODE
    bool "Enable verbose logs (state transitions)"
    default n
    help
      When enabled, logs relay index and state on each transition.

endmenu
```

## components/TouchScreen/Kconfig.projbuild
```kconfig
menu "TouchScreen settings"

config PORIS_ENABLE_TOUCHSCREEN
    bool "Enable component TouchScreen"
    default y
    help
      Enable/disable component TouchScreen at Kconfig level.
      Variant gating is handled by environment variables (PORIS_ENABLE_TOUCHSCREEN).

config TOUCHSCREEN_USE_THREAD
    bool "TouchScreen starts its own thread (TouchScreen starts its own thread)"
    default n
    help
      If enabled, TouchScreen will create a FreeRTOS task and call spin()
      periodically. If disabled, call TouchScreen_spin() yourself from
      your scheduler.
    depends on PORIS_ENABLE_TOUCHSCREEN

config TOUCHSCREEN_PERIOD_MS
    int "TouchScreen period (ms)"
    range 10 600000
    default 1000
    depends on TOUCHSCREEN_USE_THREAD

config TOUCHSCREEN_MINIMIZE_JITTER
    bool "Enable jitter minimization for execution cycles"
    default y
    help
      If active, the delay between loops will use vTaskDelayUntil() to guarantee long cycles will not shift the period, minimizing jitter.
      If deactivate, the component will use vTaskDelay() so the time it wait between cycles is the period.  Long cycles will introduce a shift in the period.
    depends on TOUCHSCREEN_USE_THREAD

choice TOUCHSCREEN_PIN_CORE
    prompt "Pin task to core"
    default TOUCHSCREEN_PIN_CORE_ANY
    depends on TOUCHSCREEN_USE_THREAD
    help
      Choose which core to pin the task to (or none).
config TOUCHSCREEN_PIN_CORE_ANY
    bool "Any core (no affinity)"
config TOUCHSCREEN_PIN_CORE_0
    bool "Core 0"
config TOUCHSCREEN_PIN_CORE_1
    bool "Core 1"
endchoice

config TOUCHSCREEN_TASK_STACK
    int "Task stack size (bytes)"
    range 2048 65536
    default 4096
    depends on TOUCHSCREEN_USE_THREAD

config TOUCHSCREEN_TASK_PRIO
    int "Task priority"
    range 1 24
    default 5
    depends on TOUCHSCREEN_USE_THREAD

endmenu
```

## components/UDPComm/Kconfig.projbuild
```kconfig
menu "UDPComm settings"

config PORIS_ENABLE_UDPCOMM
    bool "Enable component UDPComm"
    default y
    help
      Enable/disable component UDPComm at Kconfig level.
      Variant gating is handled by environment variables (PORIS_ENABLE_UDPCOMM).

config UDPCOMM_USE_THREAD
    bool "UDPComm starts its own thread (UDPComm starts its own thread)"
    default n
    help
      If enabled, UDPComm will create a FreeRTOS task and call spin()
      periodically. If disabled, call UDPComm_spin() yourself from
      your scheduler.
    depends on PORIS_ENABLE_UDPCOMM

config UDPCOMM_PERIOD_MS
    int "UDPComm period (ms)"
    range 10 600000
    default 1000
    depends on UDPCOMM_USE_THREAD

config UDPCOMM_MINIMIZE_JITTER
    bool "Enable jitter minimization for execution cycles"
    default y
    help
      If active, the delay between loops will use vTaskDelayUntil() to guarantee long cycles will not shift the period, minimizing jitter.
      If deactivate, the component will use vTaskDelay() so the time it wait between cycles is the period.  Long cycles will introduce a shift in the period.
    depends on UDPCOMM_USE_THREAD

choice UDPCOMM_PIN_CORE
    prompt "Pin task to core"
    default UDPCOMM_PIN_CORE_ANY
    depends on UDPCOMM_USE_THREAD
    help
      Choose which core to pin the task to (or none).
config UDPCOMM_PIN_CORE_ANY
    bool "Any core (no affinity)"
config UDPCOMM_PIN_CORE_0
    bool "Core 0"
config UDPCOMM_PIN_CORE_1
    bool "Core 1"
endchoice

config UDPCOMM_TASK_STACK
    int "Task stack size (bytes)"
    range 2048 65536
    default 4096
    depends on UDPCOMM_USE_THREAD

config UDPCOMM_TASK_PRIO
    int "Task priority"
    range 1 24
    default 5
    depends on UDPCOMM_USE_THREAD

endmenu
```

## components/Wifi/Kconfig.projbuild
```kconfig
menu "Wifi settings"

config PORIS_ENABLE_WIFI
    bool "Enable component Wifi"
    default y
    help
      Enable/disable component Wifi at Kconfig level.
      Variant gating is handled by environment variables (PORIS_ENABLE_WIFI).

config WIFI_CONN_SSID
    string "WiFi SSID"
    default "myssid"
    help
        SSID of the Wi-Fi network.

config WIFI_CONN_PASSWORD
    string "WiFi Password"
    default "mypass"
    help
        Password for Wi-Fi network.

endmenu
```

## tools/templates/$$1/Kconfig.projbuild
```kconfig
menu "PORIS components"

config PORIS_ENABLE_$$1
    bool "Enable component $$1"
    default y
    help
      Enable or disable component $$1 at Kconfig level.
      This is independent from the build-time variant gating by environment.

endmenu
```
